## my-board/package/vl53l1x-app/Config.in
```kconfig
config BR2_PACKAGE_VL53L1X
    bool "VL53L1X-app"
    help
      Costom sensor application
      
```

## my-board/package/vl53l1x-driver/Config.in
```kconfig
config BR2_PACKAGE_VL53L1X_DRIVER
    bool "VL53L1X-driver"
    help
      Costom VL53L1X ToF sensor kernel driver
```
